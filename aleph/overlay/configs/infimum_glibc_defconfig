## aleph/overlay/configs/infimum_glibc_defconfig
```kconfig
BR2_x86_64=y
BR2_x86_core2=y
BR2_CCACHE=y
BR2_OPTIMIZE_3=y
BR2_TOOLCHAIN_BUILDROOT_GLIBC=y
BR2_BINUTILS_VERSION_2_25=y
BR2_GCC_VERSION_4_9_X=y
BR2_TOOLCHAIN_BUILDROOT_CXX=y
BR2_GCC_ENABLE_LTO=y
BR2_TARGET_GENERIC_HOSTNAME="infimum-host"
BR2_TARGET_GENERIC_PASSWD_SHA512=y
BR2_INIT_SYSTEMD=y
BR2_ROOTFS_USERS_TABLES="board/infimum/x86_64/user_table.txt"
BR2_ROOTFS_OVERLAY="board/infimum/x86_64/rootfs_overlay"
BR2_PACKAGE_OPENSSL_BIN=y
BR2_PACKAGE_OPENSSH=y
BR2_PACKAGE_VIM=y
BR2_TARGET_ROOTFS_TAR_XZ=y
```

## buildroot/overlay/configs/infimum_glibc_defconfig
```kconfig
BR2_x86_64=y
BR2_x86_core2=y
BR2_CCACHE=y
BR2_OPTIMIZE_3=y
BR2_TOOLCHAIN_BUILDROOT_GLIBC=y
BR2_TOOLCHAIN_BUILDROOT_CXX=y
BR2_GCC_ENABLE_LTO=y
BR2_TARGET_GENERIC_PASSWD_SHA512=y
BR2_INIT_SYSTEMD=y
BR2_ROOTFS_USERS_TABLES="board/infimum/x86_64/user_table.txt"
BR2_PACKAGE_OPENSSL_BIN=y
BR2_PACKAGE_OPENSSH=y
BR2_PACKAGE_VIM=y
BR2_TARGET_ROOTFS_TAR_XZ=y
```

## buildroot/overlay/configs/infimum_uclibc_defconfig
```kconfig
BR2_x86_64=y
BR2_x86_core2=y
BR2_CCACHE=y
BR2_OPTIMIZE_3=y
BR2_TOOLCHAIN_BUILDROOT_INET_RPC=y
BR2_TOOLCHAIN_BUILDROOT_WCHAR=y
BR2_BINUTILS_VERSION_2_25=y
BR2_GCC_VERSION_4_9_X=y
BR2_TOOLCHAIN_BUILDROOT_CXX=y
BR2_GCC_ENABLE_LTO=y
BR2_TARGET_GENERIC_HOSTNAME="theinfimum"
BR2_TARGET_GENERIC_ISSUE="Welcome to Infimum Linux!"
BR2_TARGET_GENERIC_PASSWD_SHA512=y
BR2_ROOTFS_USERS_TABLES="board/infimum/x86_64/user_table.txt"
BR2_ROOTFS_OVERLAY="board/infimum/x86_64/rootfs_overlay"
BR2_PACKAGE_BUSYBOX_SHOW_OTHERS=y
BR2_PACKAGE_DBUS=y
BR2_PACKAGE_OPENSSL_BIN=y
BR2_PACKAGE_LIBCAP=y
BR2_PACKAGE_OPENSSH=y
BR2_PACKAGE_KMOD=y
BR2_PACKAGE_KMOD_TOOLS=y
BR2_PACKAGE_UTIL_LINUX=y
BR2_PACKAGE_UTIL_LINUX_LIBMOUNT=y
BR2_PACKAGE_VIM=y
BR2_TARGET_ROOTFS_TAR_XZ=y
```

## dockerhost/buildroot_overlay/configs/defconfig
```kconfig
BR2_x86_64=y
BR2_x86_core2=y
BR2_CCACHE=y
BR2_OPTIMIZE_3=y
BR2_TOOLCHAIN_BUILDROOT_GLIBC=y
BR2_TOOLCHAIN_BUILDROOT_CXX=y
BR2_GCC_ENABLE_LTO=y
BR2_TARGET_GENERIC_PASSWD_SHA512=y
BR2_INIT_SYSTEMD=y
BR2_TARGET_TZ_INFO=y
BR2_ROOTFS_USERS_TABLES="board/infimum/x86_64/user_table.txt"
BR2_LINUX_KERNEL=y
BR2_LINUX_KERNEL_USE_CUSTOM_CONFIG=y
BR2_LINUX_KERNEL_CUSTOM_CONFIG_FILE="board/infimum/x86_64/kernel.config"
BR2_LINUX_KERNEL_INSTALL_TARGET=y
BR2_PACKAGE_XZ=y
BR2_PACKAGE_GIT=y
BR2_PACKAGE_B43_FIRMWARE=y
BR2_PACKAGE_CA_CERTIFICATES=y
BR2_PACKAGE_OPENSSL_BIN=y
BR2_PACKAGE_IPTABLES=y
BR2_PACKAGE_NETWORK_MANAGER=y
BR2_PACKAGE_OPENSSH=y
BR2_PACKAGE_PROCPS_NG=y
BR2_PACKAGE_VIM=y
BR2_TARGET_ROOTFS_TAR_XZ=y
BR2_TARGET_GRUB=y
BR2_TARGET_GRUB_FS_ISO9660=y
```
